## espP4/main/Kconfig.projbuild
```kconfig
# Copyright (C) 2026 Karl Stock
# SPDX-License-Identifier: GPL-3.0-or-later
#
# This file is part of ESP32 Digitizer.
# You may redistribute and/or modify it under the GNU General Public License
# as published by the Free Software Foundation, either version 3 of the License,
# or (at your option) any later version.
#
# Distributed WITHOUT ANY WARRANTY; without even the implied warranty of
# MERCHANTABILITY or FITNESS FOR A PARTICULAR PURPOSE. See the GNU General
# Public License in the repository LICENSE file or <https://www.gnu.org/licenses/>.

menu "P4 capture diagnostics"

config P4_INPUT_SKEW
    bool "Same-pulse GPIO1/GPIO6 hardware timestamp comparison"
    default n
    help
        Standalone calibration image. Requires disconnecting ADC FSYNC from
        GPIO1 and feeding the same generator signal to GPIO1 and GPIO6.
        No ADC acquisition, Feather commands or SD access.

config P4_FSYNC_ASSOCIATION
    depends on !P4_INPUT_SKEW
    bool "RAM-only FSYNC timestamp/sample association test"
    default n
    help
        Separate startup using the real receiver and decoder. Uses GPIO1's
        existing FSYNC input, MCPWM capture and a PCNT hardware pulse counter.
        No SD writes, generated pulses or GPS capture. Pair with the external
        source Feather bench firmware. See docs/FSYNC-ASSOCIATION-TEST.md.

config P4_PULSE_DELAY
    depends on P4_FSYNC_ASSOCIATION
    bool "Also capture a direct pulse on GPIO6 to measure ADC response delay"
    default n
    help
        Uses the same timer as FSYNC and exports short raw ADC windows around
        direct edges. No output pin is driven. See docs/PULSE-DELAY-TEST.md
        before wiring; the analog and digital branches need different voltages.

config P4_SD_CHOKE
    depends on !P4_FSYNC_ASSOCIATION && !P4_INPUT_SKEW
    bool "Standalone SD file-ring tests (fresh disk / add files)"
    default n
    help
        Separate startup, no ADC or Feather. Select run fresh to format or
        run addFiles to preserve/add. Both use the session backend. One run per reset.

if P4_SD_CHOKE

config P4_CHOKE_FILE_COUNT
    int "Number of new files to preallocate per test"
    range 1 64
    default 5

config P4_CHOKE_FILE_SECONDS
    int "Payload capacity of each file in seconds at 3072000 bytes/s"
    range 1 600
    default 15

config P4_CHOKE_RUN_SECONDS
    int "Generated-input duration in seconds"
    range 1 86400
    default 300

config P4_CHOKE_RING_MIB
    int "Ring capacity in MiB (1, 2, 4, 8 or 16)"
    range 1 16
    default 16
    help
        Must be a power of two; the writer rejects other sizes at compile time.
        Allocation can fail if insufficient PSRAM remains; that fails the test.

config P4_CHOKE_LIVE_REPORT
    bool "Report buffer use once per second"
    default y

endif

config P4_DIAGNOSTICS
    depends on !P4_SD_CHOKE && !P4_FSYNC_ASSOCIATION && !P4_INPUT_SKEW
    bool "Include manual RAM and generated-data SD tests"
    default n
    help
        Select test startup with w/t/u/s commands. Ordinary recording leaves
        this disabled and contains no test generator or RAM summary objects.
        Smoke and profiling builds select test startup automatically.


config P4_HARDWARE_SMOKE
    depends on !P4_SD_CHOKE && !P4_FSYNC_ASSOCIATION && !P4_INPUT_SKEW
    bool "Thirty-second DAC-to-SD hardware smoke test"
    default n
    help
        Adds a readback waveform summary after normal SD integrity checks.
        Pair with Feather ads127-hardware-smoke. No automatic capture at boot.

config P4_CAPTURE_PROFILE
    depends on !P4_HARDWARE_SMOKE && !P4_SD_CHOKE && !P4_FSYNC_ASSOCIATION && !P4_INPUT_SKEW
    bool "Measure CPU headroom during a 60-second capture"
    default n
    select FREERTOS_GENERATE_RUN_TIME_STATS
    help
        Development-only CPU and memory measurements. Selects 60/65-second
        run/deadline timing; pair with Feather ads127-p4-capture-60s firmware.
        Samples runtime counters about once per second, prints after capture.
        Leave disabled for the normal 30-minute build. Use a separate sdkconfig
        so FreeRTOS runtime-counter overhead also stays out of normal builds.

endmenu
```

## p4Capture/main/Kconfig.projbuild
```kconfig
menu "P4 capture diagnostics"

config P4_CAPTURE_PROFILE
    bool "Measure CPU headroom during a 60-second capture"
    default n
    select FREERTOS_GENERATE_RUN_TIME_STATS
    help
        Development-only CPU and memory measurements. Selects 60/65-second
        run/deadline timing; pair with Feather ads127-p4-capture-60s firmware.
        Samples runtime counters about once per second, prints after capture.
        Leave disabled for the normal 30-minute build. Use a separate sdkconfig
        so FreeRTOS runtime-counter overhead also stays out of normal builds.

endmenu
```
